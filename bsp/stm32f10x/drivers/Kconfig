## bsp/stm32f10x/drivers/Kconfig
```kconfig
config RT_USING_PIN
    bool "Enable PIN driver (GPIO)"
    default y

if RT_USING_PIN
	config RT_USING_LED
		bool "Using LED (PB5/PE5)"
		default y
	config RT_USING_KEY
		bool "Using KEY (KEY0~4)"
		default y
	config RT_USING_BEEP
		bool "Using BEEP (PB8)"
		default y
endif
	
config BSP_USING_I2C
    bool "Enable I2C1  (PB10/11)"
    default n
    select RT_USING_I2C
    select RT_USING_I2C_BITOPS
	
menuconfig BSP_USING_SPI
    bool "Enable SPI  (Hardware)"
    default n
	if BSP_USING_SPI
		menuconfig RT_USING_SPI1
			bool "Using SPI1"
			default y			
			if RT_USING_SPI1
				config SPI1_USING_DMA
					bool "SPI1 Using DMA"
					default n
			endif
		menuconfig RT_USING_SPI2
			bool "Using SPI2"
			default n
			if RT_USING_SPI2
				config SPI2_USING_DMA
					bool "SPI2 Using DMA"
					default n
			endif
		config BSP_USING_SPI_IO
			bool "Using software SPI"
			default n
	endif

	
config RT_USING_UART1
    bool "Enable UART1 (PA9/10)"
    default y

config RT_USING_UART2
    bool "Enable UART2 (PA2/3)"
    default y

config RT_USING_UART3
    bool "Enable UART3 (PB10/11)"
    default y

config RT_USING_UART4
    bool "Enable UART4 (PC10/11)"
    default n

	

menuconfig BSP_USING_PWM1
    bool "Using PWM1"
    select RT_USING_PWM
    default n

if BSP_USING_PWM1
    config BSP_USING_PWM1_CH1
        bool "Enable Channel 1 (PE9)"
        default n
    config BSP_USING_PWM1_CH2
        bool "Enable Channel 2 (PE11)"
        default n
endif

menuconfig BSP_USING_PWM2
    bool "Using PWM2"
    select RT_USING_PWM
    default n

if BSP_USING_PWM2
    config BSP_USING_PWM2_CH1
        bool "Enable Channel 1 (PB10)"
        default n
    config BSP_USING_PWM2_CH2
        bool "Enable Channel 2 (PB11)"
        default n
    config BSP_USING_PWM2_CH3
        bool "Enable Channel 3 (PA15)"
        default n
    config BSP_USING_PWM2_CH4
        bool "Enable Channel 4 (PB3)"
        default n
endif

menuconfig BSP_USING_PWM3
    bool "Using PWM3"
    select RT_USING_PWM
    default n

if BSP_USING_PWM3
    config BSP_USING_PWM3_CH1
        bool "Enable Channel 1 (PA6)"
        default n
    config BSP_USING_PWM3_CH2
        bool "Enable Channel 2 (PA7)"
        default n
    config BSP_USING_PWM3_CH3
        bool "Enable Channel 3 (PB0)"
        default n
    config BSP_USING_PWM3_CH4
        bool "Enable Channel 4 (PB1)"
        default n
endif

menuconfig BSP_USING_PWM4
    bool "Using PWM4"
    select RT_USING_PWM
    default n

if BSP_USING_PWM4
    config BSP_USING_PWM4_CH1
        bool "Enable Channel 1 (PD12)"
        default n
    config BSP_USING_PWM4_CH2
        bool "Enable Channel 2 (PD13)"
        default n
    config BSP_USING_PWM4_CH3
        bool "Enable Channel 3 (PD14)"
        default n
    config BSP_USING_PWM4_CH4
        bool "Enable Channel 4 (PD15)"
        default n
endif

menuconfig BSP_USING_PWM5
    bool "Using PWM5"
    select RT_USING_PWM
    default n

if BSP_USING_PWM5
    config BSP_USING_PWM5_CH1
        bool "Enable Channel 1 (PA0)"
        default n
    config BSP_USING_PWM5_CH2
        bool "Enable Channel 2 (PA1)"
        default n
    config BSP_USING_PWM5_CH3
        bool "Enable Channel 3 (PA2)"
        default n
    config BSP_USING_PWM5_CH4
        bool "Enable Channel 4 (PA3)"
        default n
endif

menuconfig BSP_USING_PWM8
    bool "Using PWM8"
    select RT_USING_PWM
    default n

if BSP_USING_PWM8
    config BSP_USING_PWM8_CH1
        bool "Enable Channel 1 (PC6)"
        default n
    config BSP_USING_PWM8_CH2
        bool "Enable Channel 2 (PC7)"
        default n
    config BSP_USING_PWM8_CH3
        bool "Enable Channel 3 (PC8)"
        default n
    config BSP_USING_PWM8_CH4
        bool "Enable Channel 4 (PC9)"
        default n
endif

menuconfig RT_USING_DM9000
	bool "Enable DM9000"
	default n
	
menuconfig PKG_USING_GUIENGINE
	bool "Enable LCD (FSMC)"
	default n
	if PKG_USING_GUIENGINE
		config BSP_USING_LCD
			bool "Enable LCD (ILI9341)"
			default n
	endif
	if PKG_USING_GUIENGINE
		config RT_USING_LCD_TYPE
			string "Set LCD Type"
			default "ILI9341"
	endif
```
